#pragma once
#include <Arduino.h>

// ============================================================
// EXPERIMENTAL RELATIVE WATER-NEED MODEL
// ------------------------------------------------------------
// Classes:
//   0 = LOW_WATER_NEED
//   1 = MODERATE_WATER_NEED
//   2 = HIGH_WATER_NEED
//
// IMPORTANT:
// This is a prototype / non-clinical model. Training labels are weak
// experimental labels derived from selected 17-Aug-2026 recording
// intervals. They are NOT biochemical or clinical dehydration labels.
//
// Input: one 60-second window sampled at 5 Hz (300 records).
// Features (in this exact order):
//   gsr_mean, gsr_sd, gsr_slope,
//   red_mean, red_sd, ir_mean, ir_sd, red_ir_ratio
//
// Classifier: standardized distance-weighted k-NN, k=3.
// ============================================================

static const uint8_t HYD_FEATURE_COUNT = 8;
static const uint16_t HYD_MODEL_SAMPLES = 94;
static const uint8_t HYD_K = 3;

static const float HYD_FEATURE_MEAN[HYD_FEATURE_COUNT] = {
  1544.79648936f, 57.25465949f, 0.20345074f, 72271.78673759f,
  1598.05603707f, 104699.30255319f, 1230.19729532f, 0.68940156f
};

static const float HYD_FEATURE_STD[HYD_FEATURE_COUNT] = {
  222.93218976f, 55.60911207f, 3.05792169f, 6123.33574399f,
  2160.09527850f, 5781.59097987f, 1445.77001810f, 0.02615906f
};

static const float HYD_MODEL_Z[HYD_MODEL_SAMPLES][HYD_FEATURE_COUNT] = {
  {1.1213283f, -0.5211902f, 0.3195551f, -0.9895135f, -0.5792717f, -0.4601443f, -0.3950176f, -1.5484316f},
  {1.2018461f, -0.4371095f, -0.2235107f, -1.0850339f, -0.4669938f, -0.6428817f, -0.4891554f, -1.5103244f},
  {0.2308034f, 0.7762277f, -1.8417400f, -1.2815232f, 0.5036393f, -1.3385484f, 0.3860281f, -0.9541255f},
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  {0.6895677f, -0.6873548f, 0.1209947f, 1.8440755f, 0.1436720f, 1.6362914f, -0.1088599f, 1.6280380f}
};

static const uint8_t HYD_MODEL_LABEL[HYD_MODEL_SAMPLES] = {
  2, 2, 2, 2, 2, 2, 2, 2, 2, 2, 2, 2, 2, 2, 2, 2, 2, 2, 2, 2,
  2, 2, 2, 0, 0, 0, 0, 0, 0, 0, 0, 0, 2, 2, 0, 0, 0, 0, 0, 0,
  0, 0, 0, 0, 0, 0, 0, 0, 0, 0, 0, 0, 0, 0, 0, 0, 0, 0, 0, 0,
  0, 0, 0, 0, 0, 0, 0, 0, 0, 0, 0, 0, 0, 0, 0, 0, 0, 0, 0, 0,
  1, 1, 1, 1, 1, 1, 1, 1, 1, 1, 1, 1, 1, 1
};

struct HydrationPrediction {
  uint8_t classId;
  float probability[3];
  float wni;
  float confidence;
  float nearestDistance;
};

inline const char* hydrationClassName(uint8_t classId) {
  switch (classId) {
    case 0: return "LOW";
    case 1: return "MODERATE";
    case 2: return "HIGH";
    default: return "UNKNOWN";
  }
}

inline HydrationPrediction predictHydration(const float features[HYD_FEATURE_COUNT]) {
  HydrationPrediction result;
  result.classId = 0;
  result.probability[0] = 0.0f;
  result.probability[1] = 0.0f;
  result.probability[2] = 0.0f;
  result.wni = -1.0f;
  result.confidence = 0.0f;
  result.nearestDistance = 999.0f;

  float z[HYD_FEATURE_COUNT];

  for (uint8_t j = 0; j < HYD_FEATURE_COUNT; j++) {
    const float denom = (HYD_FEATURE_STD[j] > 1e-9f)
      ? HYD_FEATURE_STD[j]
      : 1.0f;

    z[j] = (features[j] - HYD_FEATURE_MEAN[j]) / denom;
  }

  // Keep the K smallest SQUARED Euclidean distances.
  float bestDist2[HYD_K];
  uint8_t bestLabel[HYD_K];

  for (uint8_t k = 0; k < HYD_K; k++) {
    bestDist2[k] = 1e30f;
    bestLabel[k] = 0;
  }

  for (uint16_t i = 0; i < HYD_MODEL_SAMPLES; i++) {
    float d2 = 0.0f;

    for (uint8_t j = 0; j < HYD_FEATURE_COUNT; j++) {
      float diff = z[j] - HYD_MODEL_Z[i][j];
      d2 += diff * diff;
    }

    // Insertion into sorted K-best list.
    for (uint8_t k = 0; k < HYD_K; k++) {
      if (d2 < bestDist2[k]) {
        for (int m = HYD_K - 1; m > k; m--) {
          bestDist2[m] = bestDist2[m - 1];
          bestLabel[m] = bestLabel[m - 1];
        }

        bestDist2[k] = d2;
        bestLabel[k] = HYD_MODEL_LABEL[i];
        break;
      }
    }
  }

  float score[3] = {0.0f, 0.0f, 0.0f};

  for (uint8_t k = 0; k < HYD_K; k++) {
    // Weight = 1 / (d^2 + eps)
    float weight = 1.0f / (bestDist2[k] + 0.001f);
    score[bestLabel[k]] += weight;
  }

  float scoreSum = score[0] + score[1] + score[2];

  if (scoreSum <= 0.0f) {
    result.classId = 0;
    return result;
  }

  for (uint8_t c = 0; c < 3; c++) {
    result.probability[c] = score[c] / scoreSum;
  }

  uint8_t bestClass = 0;
  float bestProb = result.probability[0];

  for (uint8_t c = 1; c < 3; c++) {
    if (result.probability[c] > bestProb) {
      bestProb = result.probability[c];
      bestClass = c;
    }
  }

  result.classId = bestClass;

  // Relative Water-Need Index:
  // LOW=0, MODERATE=0.5, HIGH=1.0
  result.wni = 100.0f * (
    0.5f * result.probability[1] +
    1.0f * result.probability[2]
  );

  result.nearestDistance = sqrtf(bestDist2[0]);

  // Classifier-output confidence only; not a clinical probability.
  // Distance penalty prevents far-out samples from appearing overly certain.
  float distanceQuality = 1.0f / (1.0f + result.nearestDistance / 3.0f);
  result.confidence = 100.0f * bestProb * distanceQuality;

  return result;
}